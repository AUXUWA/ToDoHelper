## components/ai_service/Kconfig
```kconfig
menu "ToDoHelper: AI service"

    config TODOHELPER_AI_TIMEOUT_MS
        int "DeepSeek request timeout (ms)"
        range 5000 120000
        default 45000
        help
            Reasoner models can take a while; the UI stays responsive because the
            request runs in this component's worker task, not in the LVGL task.

    config TODOHELPER_AI_SAVE_HISTORY
        bool "Persist the conversation to storage by default"
        default n
        help
            Default for the NVS key `ai_save_hist`. When enabled the conversation
            is written to <storage>/todohelper/ai/chat_history.json.

endmenu
```

## components/calendar_service/Kconfig
```kconfig
menu "ToDoHelper: calendar / time service"

    config TODOHELPER_NTP_SERVER
        string "Default NTP server"
        default "ntp.aliyun.com"
        help
            Used when the NVS key `ntp_server` is absent. The device has no RTC,
            so the clock is only valid after a successful SNTP sync.

    config TODOHELPER_TZ_DEFAULT
        string "Default POSIX timezone"
        default "CST-8"
        help
            POSIX TZ string, e.g. "CST-8" for UTC+8 or "UTC0".
            Overridable at runtime through the NVS key `tz`.

endmenu
```

## components/debug_shell/Kconfig
```kconfig
menu "ToDoHelper debug shell"

    config TODOHELPER_DEBUG_SHELL
        bool "Enable the on-device debug shell (/api/v1/debug/exec)"
        default n
        help
            Adds a small text-command shell reachable over HTTP so a developer
            can inspect and drive the device without a serial cable:

                curl -X POST -d 'widgets token' http://<dev>/api/v1/debug/exec
                curl -X POST -d 'click 知道了'   http://<dev>/api/v1/debug/exec

            It can switch pages, press widgets, dump the LVGL object tree, read
            heaps/tasks/NVS and reboot the board. That is exactly why it is
            **off by default**.

            Turn this on for a debugging build only; do not ship it enabled.

            Note on authentication (v1.5.0): the device checks no tokens until
            one is configured - that is the long-standing LAN default, and it is
            what keeps "set the first token", "configure the AI key" and this
            shell reachable. Once a token exists, *every* route needs it, this
            one included.

endmenu
```

## components/idle_face/Kconfig
```kconfig
menu "ToDoHelper: idle face"

    config TODOHELPER_IDLE_EYE_WIDTH
        int "Base eye width in pixels"
        range 60 300
        default 150

    config TODOHELPER_IDLE_EYE_HEIGHT
        int "Base eye height in pixels"
        range 40 300
        default 150

    config TODOHELPER_IDLE_EYE_GAP
        int "Horizontal gap between the eyes in pixels"
        range 20 400
        default 96

    config TODOHELPER_IDLE_LINE_WIDTH
        int "Eye outline thickness in pixels"
        range 2 20
        default 8

endmenu
```

## components/sys_utils/Kconfig
```kconfig
menu "ToDoHelper: system utilities"

    config TODOHELPER_LOG_LEVEL
        int "Default ToDoHelper log level (0=ERR 1=WARN 2=INFO 3=DEBUG)"
        range 0 3
        default 2
        help
            Compile-time default for sys_log_set_level(). It can still be changed
            at runtime by calling sys_log_set_level().

    config TODOHELPER_NVS_NAMESPACE
        string "NVS namespace used by sys_config_*"
        default "todohelper"
        help
            All components must store configuration through sys_config_* which
            uses this namespace. Key names are registered in docs/API.md.

    config TODOHELPER_EVENT_QUEUE_SIZE
        int "Shared event loop queue size"
        range 8 128
        default 32

    config TODOHELPER_EVENT_TASK_STACK
        int "Shared event loop task stack size"
        default 4096

    config TODOHELPER_EVENT_TASK_PRIO
        int "Shared event loop task priority"
        default 5

endmenu
```

## components/todo_manager/Kconfig
```kconfig
menu "ToDoHelper: todo manager"

    config TODOHELPER_TODO_CACHE_FILE
        string "Cache file name under <app_dir>/cache"
        default "todos.json"
        help
            Written with the storage layer's two-slot protocol (X.new ->
            X.bak -> X), so a power loss can never take both the old and the
            new copy with it; the leftovers are reconciled at boot. The file
            lives in the *internal* LittleFS, not on the SD card, so swapping
            the card cannot make the list disappear (v1.5.0).

    config TODOHELPER_TODO_BACKUP_KEEP
        int "Number of daily backup files to keep in backup/"
        range 0 30
        default 7
        help
            0 disables backups. Backups never contain WiFi passwords, API keys
            or the auth token (requirement 8.8).

            NOTE (v1.5.0): this knob still drives no code - the dated
            backup/todos_YYYYMMDD.json series is NOT implemented yet. What
            protects the list today is the storage layer's generic X.bak slot
            (one generation back) plus the export/import HTTP routes, which
            hand the whole list to the user's computer. Implementing the dated
            series is on the v1.6.0 list; until then, do not advertise this
            option as a working feature.

endmenu
```

## components/ui_core/Kconfig
```kconfig
menu "ToDoHelper: UI core"

    config TODOHELPER_FONT_FREETYPE
        bool "Render UI text with a scalable CJK TrueType font"
        depends on ESP_LVGL_ADAPTER_ENABLE_FREETYPE
        default n
        help
            Uses the FreeType font manager from esp_lvgl_adapter so every text
            role can have its own size while still covering Chinese glyphs.

            Requires CONFIG_ESP_LVGL_ADAPTER_ENABLE_FREETYPE, which in turn
            requires CONFIG_LV_USE_FREETYPE.

            The font is looked up in this order:
              1. <storage>/todohelper/<TODOHELPER_FONT_PATH>
              2. the subset embedded in the firmware (components/ui_core/fonts)
              3. LVGL's built-in Source Han Sans SC CJK font
              4. LVGL's built-in Montserrat font (Latin only)
            so the UI keeps working even when every optional piece is missing.

    config TODOHELPER_FONT_IN_RAM
        bool "Keep the TrueType font in RAM instead of reading it from the SD card"
        depends on TODOHELPER_FONT_FREETYPE
        default y
        help
            FreeType reads the .ttf with plain fopen()/fread(), so a font file
            on the SD card made every single glyph cost ~9.8 ms of card reads
            (FreeType's own work is 100~200 us). With this option the font is
            copied into PSRAM at boot and served from a read-only RAM
            filesystem (components/ui_core/src/ui_font_ramfs.c), which turns
            those reads into a memcpy.

            Measured on the ESP32-S31-Korvo: drawing 33 characters that were
            not in the glyph cache took 8.8 ms with the font in RAM against
            ~330 ms when it was read from the SD card.

            The cost is the boot time to read the file (1.25 MB: ~390 ms from
            the SD card) plus 1.25 MB of PSRAM. Turn this off if the boot
            delay matters more than the drawing speed.

    config TODOHELPER_FONT_PATH
        string "TrueType font on storage, relative to the app data directory"
        depends on TODOHELPER_FONT_FREETYPE
        default "fonts/ui.ttf"
        help
            Dropping a .ttf at <storage>/todohelper/fonts/ui.ttf overrides the
            firmware font without reflashing.

    config TODOHELPER_FPS_PROBE
        bool "Log the measured refresh rate once a second (diagnostic)"
        depends on ESP_LVGL_ADAPTER_ENABLE_FPS_STATS
        default n
        help
            Enables the adapter's FPS counter and logs "fps N" from the
            once-a-second status bar timer, so smoothness changes can be judged
            from measurements rather than impressions.

            Costs a little CPU and one log line per second: keep it off in
            normal builds, turn it on when comparing before/after.

endmenu
```

## components/voice_service/Kconfig
```kconfig
menu "ToDoHelper: voice service"

    config TODOHELPER_VOICE_HTTP_TIMEOUT_MS
        int "ASR / TTS request timeout (ms)"
        range 5000 120000
        default 30000
        help
            Cloud speech endpoints can be slow; the request runs in this
            component's task so the UI stays responsive.

    config TODOHELPER_VOICE_SAVE_PCM
        bool "Save each recording to storage"
        default y
        help
            Writes <storage>/todohelper/ai/rec_<timestamp>.pcm so a recording can
            be inspected or replayed. Raw 16 kHz / 16-bit / mono, no WAV header.

    config TODOHELPER_VOICE_KEEP_PCM
        int "Number of recordings kept on storage"
        range 0 50
        default 5
        help
            0 disables saving. Older files are not deleted automatically yet;
            see docs/API.md 已知限制.

endmenu
```

## components/weather_service/Kconfig
```kconfig
menu "ToDoHelper: weather service"

    config TODOHELPER_WEATHER_INTERVAL_S
        int "Default refresh period (seconds)"
        range 300 86400
        default 900
        help
            Requirement FR3 asks for 15 minutes. Overridable at runtime through
            the NVS key `weather_int`.

    config TODOHELPER_WEATHER_HTTP_TIMEOUT_MS
        int "HTTP timeout for weather requests (ms)"
        range 3000 60000
        default 12000

endmenu
```

## components/wifi_manager/Kconfig
```kconfig
menu "ToDoHelper: WiFi manager"

    config TODOHELPER_WIFI_AUTO_CONNECT
        bool "Reconnect to the saved network on boot"
        default y
        help
            Reads wifi_ssid / wifi_pass / wifi_auto from NVS during
            wifi_manager_init() and connects automatically.

    config TODOHELPER_WIFI_RECONNECT_ATTEMPTS
        int "Automatic reconnect attempts after an unexpected disconnect"
        range 0 20
        default 5

    config TODOHELPER_WIFI_RECONNECT_DELAY_MS
        int "Delay between automatic reconnect attempts (ms)"
        range 500 60000
        default 3000

    config TODOHELPER_WIFI_SCAN_MAX_APS
        int "Maximum access points cached from one scan"
        range 4 64
        default 24

endmenu
```

## components/word_service/Kconfig
```kconfig
menu "ToDoHelper: word service"

    config TODOHELPER_WORD_DAILY_COUNT
        int "Default number of words per day"
        range 1 100
        default 10
        help
            Overridable at runtime through the NVS key `word_daily`.

    config TODOHELPER_WORD_EXPORT_TEMPLATE
        bool "Write the starter wordbook to storage when none is present"
        default y
        help
            Copies the compiled-in sample book to
            <storage>/todohelper/words/<book>.json so it can be edited or
            replaced with a real CET4/CET6 list without reflashing.

endmenu
```
